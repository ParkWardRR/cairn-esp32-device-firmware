/*
 * Host conformance runner for the firmware's C implementation of bundle
 * format v3.
 *
 * This is the only way to establish that the firmware's format code is correct
 * without a device in hand. The vectors in contracts/format/v3/vectors/ are bytes and
 * expected verdicts generated by the Go reference implementation and committed;
 * the Rust implementation is checked against the same files. If this runner
 * disagrees about a single byte or a single verdict, the firmware would write
 * bundles the server cannot recover — so a failure here is a release blocker,
 * not a warning.
 *
 * Every segment vector is checked twice: structurally, with no key, and keyed,
 * with the public test root from keys.json. The keyed check also re-seals each
 * authenticated frame with the writer's own function and its stored nonce, so
 * the encrypt direction is pinned to the reference byte for byte, not only the
 * decrypt direction.
 *
 * Ed25519 gets a stronger check than "a signature verifies". Because Ed25519 is
 * deterministic, signing the committed manifest bytes with the committed seed
 * must reproduce manifest.sig exactly. That catches a subtly wrong field
 * implementation, which a verify-only test would not.
 *
 * Before any vector, the primitives are checked against their own published
 * known answers (HChaCha20 and XChaCha20-Poly1305 from
 * draft-irtf-cfrg-xchacha-03, HKDF from RFC 5869), so a failure says which
 * layer is wrong.
 *
 * Build and run: make -C firmware/cairn-v2/test/host
 */

#include <stdarg.h>
#include <stdint.h>
#include <stdio.h>
#include <stdlib.h>
#include <string.h>

#include "cairn_format.h"
#include "minijson.h"
#include "policy.h"

/* The fixed seeds used by server/cmd/mkvectors. Deterministic vectors matter
 * more than unpredictable keys for a test corpus. */
static const char DEVICE_KEY_SEED[] = "cairn-format-v3-device-key-seed!";
static const char SERVER_KEY_SEED[] = "cairn-format-v3-server-key-seed!";

static int    g_checked, g_passed;
static char   g_failures[64][512];
static int    g_failure_count;
static char   g_skipped[64][128];
static int    g_skipped_count;

static void record_failure(const char *vector, const char *fmt, ...)
{
    if (g_failure_count >= 64) return;

    char detail[400];
    va_list ap;
    va_start(ap, fmt);
    vsnprintf(detail, sizeof(detail), fmt, ap);
    va_end(ap);

    snprintf(g_failures[g_failure_count++], 512, "%s: %s", vector, detail);
}

/* ── small helpers ────────────────────────────────────────────────────────── */

static uint8_t *read_file(const char *path, size_t *len)
{
    FILE *f = fopen(path, "rb");
    if (f == NULL) return NULL;

    fseek(f, 0, SEEK_END);
    long size = ftell(f);
    fseek(f, 0, SEEK_SET);

    if (size < 0) {
        fclose(f);
        return NULL;
    }

    uint8_t *buf = malloc((size_t)size + 1);
    if (buf == NULL) {
        fclose(f);
        return NULL;
    }

    size_t got = fread(buf, 1, (size_t)size, f);
    fclose(f);

    buf[got] = '\0'; /* so the same loader can serve JSON text */
    *len = got;
    return buf;
}

static uint32_t get_u32_le(const uint8_t *p)
{
    return (uint32_t)p[0] | ((uint32_t)p[1] << 8) | ((uint32_t)p[2] << 16) |
           ((uint32_t)p[3] << 24);
}

static int hex_nibble(char c)
{
    if (c >= '0' && c <= '9') return c - '0';
    if (c >= 'a' && c <= 'f') return c - 'a' + 10;
    if (c >= 'A' && c <= 'F') return c - 'A' + 10;
    return -1;
}

static bool unhex(const char *hex, uint8_t *out, size_t out_len)
{
    if (strlen(hex) != out_len * 2) return false;

    for (size_t i = 0; i < out_len; i++) {
        int hi = hex_nibble(hex[i * 2]);
        int lo = hex_nibble(hex[i * 2 + 1]);
        if (hi < 0 || lo < 0) return false;
        out[i] = (uint8_t)((hi << 4) | lo);
    }
    return true;
}

static void tohex(const uint8_t *b, size_t len, char *out)
{
    static const char *d = "0123456789abcdef";
    for (size_t i = 0; i < len; i++) {
        out[i * 2]     = d[b[i] >> 4];
        out[i * 2 + 1] = d[b[i] & 0x0f];
    }
    out[len * 2] = '\0';
}

/*
 * Resolve an expected record_counts key back to a type byte. Known types are
 * matched by name; unknown ones appear as "UNKNOWN(0x7f)", carrying the byte
 * that an older decoder could not identify.
 */
static bool resolve_record_type(const char *name, uint8_t *out)
{
    if (strncmp(name, "UNKNOWN(0x", 10) == 0) {
        long v = strtol(name + 10, NULL, 16);
        if (v < 0 || v > 0xFF) return false;
        *out = (uint8_t)v;
        return true;
    }

    for (int t = 0; t < 256; t++) {
        if (!cairn_record_type_known((uint8_t)t)) continue;
        if (strcmp(cairn_record_type_name((uint8_t)t), name) == 0) {
            *out = (uint8_t)t;
            return true;
        }
    }
    return false;
}

/* ── scan vectors ─────────────────────────────────────────────────────────── */

/*
 * The vector root key, from keys.json. A verifier is given version 1 only, and
 * derives every segment key from the segment's own header — the header, not
 * the caller, says which key applies.
 */
static cairn_root_key_t g_root;
static bool             g_have_root;

static int g_keyed_checked, g_keyed_passed;

static bool compare_scan(const char *vector, const char *prefix,
                         const cairn_scan_result_t *res,
                         const mj_doc_t *doc, const mj_node_t *exp)
{
    const char *want_reason = mj_str_or(mj_get(doc, exp, "stop_reason"), "");
    const char *got_reason  = cairn_stop_reason_name(res->stop);

    if (strcmp(got_reason, want_reason) != 0) {
        record_failure(vector, "%sstop_reason = %s, want %s", prefix, got_reason,
                       want_reason);
        return false;
    }

    size_t want_frames = (size_t)mj_num_or(mj_get(doc, exp, "frames_retained"), -1);
    if (res->frames != want_frames) {
        record_failure(vector, "%sframes_retained = %zu, want %zu", prefix,
                       res->frames, want_frames);
        return false;
    }

    size_t want_offset = (size_t)mj_num_or(mj_get(doc, exp, "stop_offset"), -1);
    if (res->stop_offset != want_offset) {
        record_failure(vector, "%sstop_offset = %zu, want %zu", prefix,
                       res->stop_offset, want_offset);
        return false;
    }

    uint32_t want_discarded =
        (uint32_t)mj_num_or(mj_get(doc, exp, "discarded_tail_bytes"), -1);
    if (res->discarded_tail_bytes != want_discarded) {
        record_failure(vector, "%sdiscarded_tail_bytes = %u, want %u", prefix,
                       res->discarded_tail_bytes, want_discarded);
        return false;
    }

    size_t want_unknown =
        (size_t)mj_num_or(mj_get(doc, exp, "unknown_type_count"), -1);
    if (res->unknown_type_count != want_unknown) {
        record_failure(vector, "%sunknown_type_count = %zu, want %zu", prefix,
                       res->unknown_type_count, want_unknown);
        return false;
    }

    const mj_node_t *counts = mj_get(doc, exp, "record_counts");
    size_t listed = 0;
    for (const mj_node_t *m = mj_first(doc, counts); m != NULL; m = mj_next(doc, m)) {
        uint8_t type;
        if (!resolve_record_type(m->key, &type)) {
            record_failure(vector, "%sunrecognized record_counts key %s", prefix,
                           m->key);
            return false;
        }

        size_t want = (size_t)mj_num_or(m, -1);
        if (res->record_counts[type] != want) {
            record_failure(vector, "%srecord_counts[%s] = %zu, want %zu", prefix,
                           m->key, res->record_counts[type], want);
            return false;
        }
        listed += want;
    }

    /* And nothing counted that the vector does not list. */
    if (counts != NULL && listed != res->frames) {
        record_failure(vector, "%srecord_counts sum to %zu, but %zu frames were "
                               "retained", prefix, listed, res->frames);
        return false;
    }

    /* first_seq and last_seq are absent for an empty segment, where there is no
     * frame to describe. An absent key is not a zero. */
    const mj_node_t *first = mj_get(doc, exp, "first_seq");
    if (first != NULL && !mj_is_null(first)) {
        if (res->frames == 0) {
            record_failure(vector, "%sexpected frames, got none", prefix);
            return false;
        }
        uint32_t want = (uint32_t)mj_num_or(first, -1);
        if (res->first_seq != want) {
            record_failure(vector, "%sfirst_seq = %u, want %u", prefix,
                           res->first_seq, want);
            return false;
        }
    }

    const mj_node_t *last = mj_get(doc, exp, "last_seq");
    if (last != NULL && !mj_is_null(last) && res->frames > 0) {
        uint32_t want = (uint32_t)mj_num_or(last, -1);
        if (res->last_seq != want) {
            record_failure(vector, "%slast_seq = %u, want %u", prefix,
                           res->last_seq, want);
            return false;
        }
    }

    return true;
}

/* A structural scan must never expose a payload: ciphertext handed to a payload
 * parser would decode as a plausible record of random numbers. */
static bool g_structural_leak;

static bool structural_cb(const cairn_frame_t *f, void *user)
{
    (void)user;
    if (f->decrypted || f->payload != NULL || f->payload_len != 0 ||
        f->sealed == NULL || f->sealed_len < CAIRN_AEAD_OVERHEAD) {
        g_structural_leak = true;
    }
    return true;
}

static bool structural_scan(const char *vector, const char *prefix,
                            const uint8_t *bytes, size_t len, cairn_scan_state_t state,
                            cairn_scan_result_t *res)
{
    cairn_scan_opts_t opts = { NULL, NULL, structural_cb, NULL };

    g_structural_leak = false;
    cairn_err_t err = cairn_scan_segment(bytes, len, state, &opts, res);
    if (err != CAIRN_OK) {
        record_failure(vector, "%sstructural scan returned an error: %s", prefix,
                       cairn_strerror(err));
        return false;
    }
    if (res->keyed) {
        record_failure(vector, "%sa scan with no key reported itself keyed", prefix);
        return false;
    }
    if (g_structural_leak) {
        record_failure(vector, "%sa frame of a keyless scan exposed a payload", prefix);
        return false;
    }
    return true;
}

/*
 * What a keyed scan's callback sees, and the writer-side check made from it.
 *
 * Every authenticated frame is re-sealed with cairn_encode_frame — the exact
 * function the store writes with — using the frame's own nonce and header
 * fields, and must reproduce the stored bytes exactly. The keyed verdict alone
 * proves only that this implementation can *open* what Go sealed; this proves
 * it *seals* what Go would, which is the direction a device actually exercises.
 */
typedef struct {
    const uint8_t         *bytes;
    size_t                 offset;
    cairn_segment_cipher_t cipher;
    bool                   have_cipher;
    cairn_sha256_t         digest;
    bool                   reseal_mismatch;
    size_t                 mismatch_at;
} keyed_ctx_t;

static bool keyed_cb(const cairn_frame_t *f, void *user)
{
    keyed_ctx_t *k = (keyed_ctx_t *)user;

    uint8_t len_le[4] = {
        (uint8_t)f->payload_len, (uint8_t)(f->payload_len >> 8),
        (uint8_t)(f->payload_len >> 16), (uint8_t)(f->payload_len >> 24),
    };
    cairn_sha256_update(&k->digest, len_le, sizeof(len_le));
    if (f->payload_len > 0) cairn_sha256_update(&k->digest, f->payload, f->payload_len);

    size_t frame_len = CAIRN_FRAME_OVERHEAD + f->payload_len;
    const uint8_t *stored = k->bytes + k->offset;

    if (k->have_cipher && !k->reseal_mismatch) {
        static uint8_t resealed[CAIRN_MAX_FRAME_LEN];
        size_t   written = 0;
        uint32_t crc = 0;
        cairn_err_t err = cairn_encode_frame(
            &k->cipher, stored + CAIRN_FRAME_HEADER_SIZE, f->record_type,
            f->schema_version, f->flags, f->seq, f->monotonic_ms, f->prev_crc32,
            f->payload, f->payload_len, resealed, sizeof(resealed), &written, &crc);

        if (err != CAIRN_OK || written != frame_len ||
            memcmp(resealed, stored, frame_len) != 0 || crc != f->crc32) {
            k->reseal_mismatch = true;
            k->mismatch_at = k->offset;
        }
    }

    k->offset += frame_len;
    return true;
}

static bool hex_equals(const char *vector, const char *prefix, const char *what,
                       const uint8_t *got, size_t len, const char *want_hex)
{
    char hex[129];
    tohex(got, len, hex);
    if (strcmp(hex, want_hex) != 0) {
        record_failure(vector, "%s%s = %s, want %s", prefix, what, hex, want_hex);
        return false;
    }
    return true;
}

/*
 * The keyed verdict: scan with K_root version 1, then check the derived key,
 * the stop, and the digest of the plaintext retained.
 *
 * The segment key is re-derived here independently of the scanner and compared
 * with the committed value, so a KDF regression reports as that rather than as
 * a puzzling tag failure.
 */
static bool check_keyed(const char *vector, const char *prefix, const uint8_t *bytes,
                        size_t len, cairn_scan_state_t state, const mj_doc_t *doc,
                        const mj_node_t *exp)
{
    g_keyed_checked++;

    if (!g_have_root) {
        record_failure(vector, "%sno root key loaded from keys.json", prefix);
        return false;
    }

    /* The buffer must come back untouched: a keyed scan decrypts in its own
     * stage, never in the caller's bytes. */
    uint8_t before[32], after[32];
    cairn_sha256(bytes, len, before);

    static keyed_ctx_t k;
    memset(&k, 0, sizeof(k));
    k.bytes = bytes;
    cairn_sha256_init(&k.digest);

    cairn_scan_opts_t   opts = { cairn_root_key_provider, &g_root, keyed_cb, &k };
    cairn_scan_result_t res;

    /* Header first, for the cipher the re-seal check needs. */
    cairn_segment_header_t h;
    size_t                 hlen = 0;
    if (cairn_parse_segment_header(bytes, len, &h, &hlen) == CAIRN_OK) {
        k.offset = hlen;
        uint8_t seg_key[CAIRN_SEGMENT_KEY_SIZE];
        cairn_derive_segment_key(g_root.root, &h, seg_key);
        k.have_cipher = cairn_segment_cipher_init(&k.cipher, seg_key, bytes, hlen)
                        == CAIRN_OK;
    }

    cairn_err_t err = cairn_scan_segment(bytes, len, state, &opts, &res);

    cairn_sha256(bytes, len, after);
    if (memcmp(before, after, 32) != 0) {
        record_failure(vector, "%sthe keyed scan modified the caller's buffer", prefix);
        return false;
    }

    const char *want_error = mj_str_or(mj_get(doc, exp, "error"), "");
    if (want_error[0] != '\0') {
        const char *got = "none";
        if (err == CAIRN_ERR_KEY_VERSION_MISMATCH) got = "KEY_VERSION_MISMATCH";
        else if (err == CAIRN_ERR_NO_KEY) got = "NO_KEY";
        else if (err != CAIRN_OK) got = cairn_strerror(err);

        if (strcmp(got, want_error) != 0) {
            record_failure(vector, "%skeyed scan error = %s, want %s", prefix, got,
                           want_error);
            return false;
        }
        g_keyed_passed++;
        return true;
    }

    if (err != CAIRN_OK) {
        record_failure(vector, "%skeyed scan returned an error: %s", prefix,
                       cairn_strerror(err));
        return false;
    }
    if (!res.keyed) {
        record_failure(vector, "%sa scan with a key did not authenticate", prefix);
        return false;
    }

    uint8_t seg_key[CAIRN_SEGMENT_KEY_SIZE];
    cairn_derive_segment_key(g_root.root, &res.header, seg_key);
    if (!hex_equals(vector, prefix, "segment key", seg_key, sizeof(seg_key),
                    mj_str_or(mj_get(doc, exp, "segment_key_hex"), ""))) {
        return false;
    }

    const char *want_reason = mj_str_or(mj_get(doc, exp, "stop_reason"), "");
    if (strcmp(cairn_stop_reason_name(res.stop), want_reason) != 0) {
        record_failure(vector, "%skeyed stop_reason = %s, want %s", prefix,
                       cairn_stop_reason_name(res.stop), want_reason);
        return false;
    }

    const mj_node_t *frames = mj_get(doc, exp, "frames_retained");
    if (frames != NULL && res.frames != (size_t)mj_num_or(frames, -1)) {
        record_failure(vector, "%skeyed frames_retained = %zu, want %zu", prefix,
                       res.frames, (size_t)mj_num_or(frames, -1));
        return false;
    }

    const mj_node_t *offset = mj_get(doc, exp, "stop_offset");
    if (offset != NULL && res.stop_offset != (size_t)mj_num_or(offset, -1)) {
        record_failure(vector, "%skeyed stop_offset = %zu, want %zu", prefix,
                       res.stop_offset, (size_t)mj_num_or(offset, -1));
        return false;
    }

    uint8_t digest[32];
    cairn_sha256_final(&k.digest, digest);
    if (!hex_equals(vector, prefix, "plaintext digest", digest, sizeof(digest),
                    mj_str_or(mj_get(doc, exp, "plaintext_sha256_hex"), ""))) {
        return false;
    }

    if (k.reseal_mismatch) {
        record_failure(vector, "%sre-sealing the frame at offset %zu with its own "
                               "nonce did not reproduce the stored bytes — the "
                               "writer would seal differently from the reference",
                       prefix, k.mismatch_at);
        return false;
    }

    g_keyed_passed++;
    return true;
}

/*
 * max-frame: 4096 is accepted, and the two out-of-range lengths either side of
 * the valid window must be torn tails rather than trusted — 4097 so a scan
 * cannot be talked into reading past the stage, 67 so it cannot make zero
 * progress on a frame too small to hold its own envelope.
 */
static bool check_frame_len_bounds(const char *vector, const uint8_t *bytes, size_t len,
                                   size_t header_len)
{
    if (len < header_len + 2) return true;

    static uint8_t copy[8192];
    if (len > sizeof(copy)) return true;

    const uint16_t bad[] = { CAIRN_MAX_FRAME_LEN + 1, CAIRN_MIN_FRAME_LEN - 1 };
    for (size_t i = 0; i < sizeof(bad) / sizeof(bad[0]); i++) {
        memcpy(copy, bytes, len);
        copy[header_len]     = (uint8_t)bad[i];
        copy[header_len + 1] = (uint8_t)(bad[i] >> 8);

        cairn_scan_result_t res;
        cairn_scan_state_t  zero = { 0, 0 };
        if (cairn_scan_segment(copy, len, zero, NULL, &res) != CAIRN_OK ||
            res.stop != CAIRN_STOP_TORN_TAIL || res.frames != 0) {
            record_failure(vector, "frame_len %u was not rejected as a torn tail",
                           (unsigned)bad[i]);
            return false;
        }
    }
    return true;
}

static bool check_scan(const char *dir, const char *vector,
                       const mj_doc_t *doc, const mj_node_t *exp,
                       const mj_node_t *keyed)
{
    char path[512];
    snprintf(path, sizeof(path), "%s/segment.bin", dir);

    size_t len;
    uint8_t *bytes = read_file(path, &len);
    if (bytes == NULL) {
        record_failure(vector, "cannot read segment.bin");
        return false;
    }

    cairn_scan_result_t res;
    cairn_scan_state_t state = { 0, 0 };

    bool ok = structural_scan(vector, "", bytes, len, state, &res) &&
              compare_scan(vector, "", &res, doc, exp);

    if (ok && strcmp(vector, "max-frame") == 0) {
        ok = check_frame_len_bounds(vector, bytes, len, res.header_len);
    }

    /* The keyed verdict is checked even when the structural one failed, so a
     * run reports every disagreement rather than the first. */
    if (keyed != NULL) {
        ok = check_keyed(vector, "keyed: ", bytes, len, state, doc, keyed) && ok;
    }

    free(bytes);
    return ok;
}

static bool check_multi_segment(const char *dir, const char *vector,
                                const mj_doc_t *doc, const mj_node_t *exp,
                                const mj_node_t *segments)
{
    const mj_node_t *keyed = mj_get(doc, exp, "keyed");
    size_t count = mj_len(doc, segments);

    static uint8_t *bytes[8];
    static size_t   lens[8];
    if (count > 8) {
        record_failure(vector, "%zu segments is more than this runner holds", count);
        return false;
    }

    for (size_t i = 0; i < count; i++) {
        char path[512];
        snprintf(path, sizeof(path), "%s/segment-%zu.bin", dir, i);
        bytes[i] = read_file(path, &lens[i]);
        if (bytes[i] == NULL) {
            record_failure(vector, "cannot read segment-%zu.bin", i);
            for (size_t j = 0; j < i; j++) free(bytes[j]);
            return false;
        }
    }

    bool ok = true;

    /*
     * Thread the structural state from each segment into the next, and do the
     * same for the keyed scan from its own states: the chain runs bundle-wide,
     * and each mode must reach the same verdict on it.
     */
    cairn_scan_state_t state = { 0, 0 };
    for (size_t i = 0; i < count && ok; i++) {
        char prefix[64];
        snprintf(prefix, sizeof(prefix), "segment %zu: ", i);

        cairn_scan_result_t res;
        ok = structural_scan(vector, prefix, bytes[i], lens[i], state, &res) &&
             compare_scan(vector, prefix, &res, doc, mj_at(doc, segments, i));

        if (ok && keyed != NULL) {
            char kprefix[64];
            snprintf(kprefix, sizeof(kprefix), "segment %zu keyed: ", i);
            ok = check_keyed(vector, kprefix, bytes[i], lens[i], state, doc,
                             mj_at(doc, keyed, i));
        }
        state = res.next;
    }

    /*
     * Scanning the second segment from a zero state must be reported as a chain
     * break rather than quietly accepted: the chain runs bundle-wide, so a
     * decoder that lost the preceding segment must say so.
     */
    const mj_node_t *from_zero = mj_get(doc, exp, "segment_1_from_zero_state");
    if (ok && count > 1) {
        cairn_scan_result_t res;
        cairn_scan_state_t  zero = { 0, 0 };
        ok = structural_scan(vector, "segment 1 from zero: ", bytes[1], lens[1], zero,
                             &res);
        if (ok && from_zero != NULL) {
            ok = compare_scan(vector, "segment 1 from zero: ", &res, doc, from_zero);
        } else if (ok && res.stop != CAIRN_STOP_CHAIN_BREAK) {
            record_failure(vector, "scanning segment 1 from a zero state gave %s, "
                                   "want CHAIN_BREAK",
                           cairn_stop_reason_name(res.stop));
            ok = false;
        }
    }

    for (size_t i = 0; i < count; i++) free(bytes[i]);
    return ok;
}

/*
 * A header-error vector: the scan must refuse the segment outright, with the
 * error the vector names. "Some error" is not enough — a bad CRC and a bad
 * magic call for different operator responses.
 */
static bool check_header(const char *dir, const char *vector, const mj_doc_t *doc,
                         const mj_node_t *exp)
{
    char path[512];
    snprintf(path, sizeof(path), "%s/segment.bin", dir);

    size_t len;
    uint8_t *bytes = read_file(path, &len);
    if (bytes == NULL) {
        record_failure(vector, "cannot read segment.bin");
        return false;
    }

    cairn_scan_result_t res;
    cairn_scan_state_t state = { 0, 0 };
    cairn_err_t err = cairn_scan_segment(bytes, len, state, NULL, &res);

    /* A keyed scan must refuse it the same way, before any key is derived. */
    cairn_scan_opts_t opts = { cairn_root_key_provider, &g_root, NULL, NULL };
    cairn_err_t kerr = cairn_scan_segment(bytes, len, state, &opts, &res);
    free(bytes);

    if (err == CAIRN_OK || kerr != err) {
        record_failure(vector, "expected a header parse error from both scans, got "
                               "%s and %s", cairn_strerror(err), cairn_strerror(kerr));
        return false;
    }

    const char *want = mj_str_or(mj_get(doc, exp, "parse_error"), "");
    struct {
        const char *name;
        cairn_err_t err;
    } names[] = {
        { "bad_header_crc", CAIRN_ERR_BAD_HEADER_CRC },
        { "bad_magic",      CAIRN_ERR_BAD_MAGIC },
        { "short_header",   CAIRN_ERR_SHORT_HEADER },
        { "unsupported_format_version", CAIRN_ERR_UNSUPPORTED_VERSION },
    };
    for (size_t i = 0; i < sizeof(names) / sizeof(names[0]); i++) {
        if (strcmp(want, names[i].name) == 0 && err != names[i].err) {
            record_failure(vector, "header error = %s, want %s", cairn_strerror(err),
                           want);
            return false;
        }
    }
    return true;
}

/* ── manifest vectors ─────────────────────────────────────────────────────── */

static bool check_manifest(const char *dir, const char *vector,
                           const mj_doc_t *doc, const mj_node_t *exp)
{
    char path[512];
    size_t enc_len, sig_len;

    snprintf(path, sizeof(path), "%s/manifest.cbor", dir);
    uint8_t *encoded = read_file(path, &enc_len);
    if (encoded == NULL) {
        record_failure(vector, "cannot read manifest.cbor");
        return false;
    }

    snprintf(path, sizeof(path), "%s/manifest.sig", dir);
    uint8_t *sig = read_file(path, &sig_len);
    if (sig == NULL || sig_len != 64) {
        record_failure(vector, "manifest.sig is missing or not 64 bytes");
        free(encoded);
        free(sig);
        return false;
    }

    bool want_valid     = mj_bool_or(mj_get(doc, exp, "valid"), false);
    bool want_sig_valid = mj_bool_or(mj_get(doc, exp, "signature_valid"), false);

    uint8_t pub[32];
    const char *pub_hex = mj_str_or(mj_get(doc, exp, "device_public_key_hex"), "");
    if (!unhex(pub_hex, pub, 32)) {
        record_failure(vector, "device_public_key_hex is not 32 bytes of hex");
        goto fail;
    }

    /* The bytes must parse as canonical regardless of signature validity: a bad
     * signature does not make the encoding malformed. */
    cairn_manifest_t m;
    static uint8_t scratch[CAIRN_MANIFEST_ENCODED_MAX];
    cairn_err_t derr = cairn_manifest_decode(encoded, enc_len, &m, scratch,
                                             sizeof(scratch));
    if (want_valid && derr != CAIRN_OK) {
        record_failure(vector, "cairn_manifest_decode: %s", cairn_strerror(derr));
        goto fail;
    }

    if (!want_valid) {
        /* Refused as a whole: the signature verdict is not asserted (C verifies the
         * signature over the raw bytes, which is genuine here; the refusal is the
         * parse). */
        if (derr == CAIRN_OK) {
            record_failure(vector, "manifest decoded but the vector says it is invalid");
            goto fail;
        }
        goto done;
    }

    cairn_err_t verr = cairn_manifest_verify(encoded, enc_len, sig, pub);
    if (want_sig_valid && verr != CAIRN_OK) {
        record_failure(vector, "signature should verify: %s", cairn_strerror(verr));
        goto fail;
    }
    if (!want_sig_valid && verr == CAIRN_OK) {
        record_failure(vector, "signature verified but the vector expects failure");
        goto fail;
    }

    if (derr != CAIRN_OK) goto done; /* nothing further to check */

    uint8_t want_root[32];
    const char *root_hex = mj_str_or(mj_get(doc, exp, "content_root_hex"), "");
    if (!unhex(root_hex, want_root, 32)) {
        record_failure(vector, "content_root_hex is not 32 bytes of hex");
        goto fail;
    }
    if (memcmp(m.content_root, want_root, 32) != 0) {
        char got[65];
        tohex(m.content_root, 32, got);
        record_failure(vector, "content_root = %s, want %s", got, root_hex);
        goto fail;
    }

    cairn_err_t crerr = cairn_manifest_verify_content_root(&m);
    if (crerr != CAIRN_OK) {
        record_failure(vector, "verify_content_root: %s", cairn_strerror(crerr));
        goto fail;
    }

    /*
     * Re-encoding must reproduce the committed bytes exactly. This is the check
     * that catches an accidental encoding divergence between implementations.
     */
    const char *canon_hex =
        mj_str_or(mj_get(doc, exp, "canonical_bytes_sha256_hex"), "");
    if (canon_hex[0] != '\0') {
        static uint8_t reencoded[8192];
        size_t written;

        cairn_err_t eerr = cairn_manifest_encode(&m, reencoded, sizeof(reencoded),
                                                 &written);
        if (eerr != CAIRN_OK) {
            record_failure(vector, "cairn_manifest_encode: %s",
                           cairn_strerror(eerr));
            goto fail;
        }

        uint8_t digest[32];
        char got[65];
        cairn_sha256(reencoded, written, digest);
        tohex(digest, 32, got);

        if (strcmp(got, canon_hex) != 0) {
            record_failure(vector,
                           "re-encoded manifest digest = %s, want %s — this "
                           "implementation does not produce byte-identical output",
                           got, canon_hex);
            goto fail;
        }

        /*
         * Ed25519 is deterministic, so signing these exact bytes with the
         * vector's seed must reproduce manifest.sig byte for byte. A
         * verify-only test would accept a signer that is subtly wrong; this
         * does not.
         */
        if (want_sig_valid) {
            uint8_t seed[32], derived_pub[32], produced[64];

            memcpy(seed, DEVICE_KEY_SEED, 32);
            cairn_ed25519_public_from_seed(seed, derived_pub);

            if (memcmp(derived_pub, pub, 32) != 0) {
                char got_pub[65];
                tohex(derived_pub, 32, got_pub);
                record_failure(vector,
                               "public key derived from the vector seed = %s, "
                               "want %s",
                               got_pub, pub_hex);
                goto fail;
            }

            cairn_ed25519_sign(encoded, enc_len, seed, pub, produced);
            if (memcmp(produced, sig, 64) != 0) {
                char got_sig[129], want_sig[129];
                tohex(produced, 64, got_sig);
                tohex(sig, 64, want_sig);
                record_failure(vector,
                               "deterministic signature = %s, want %s — signing "
                               "diverges from the reference implementation",
                               got_sig, want_sig);
                goto fail;
            }
        }
    }

done:
    free(encoded);
    free(sig);
    return true;

fail:
    free(encoded);
    free(sig);
    return false;
}

/* ── manifest binding (§5.4) ──────────────────────────────────────────────── */

/*
 * Check every member segment the manifest lists against it.
 *
 * The members' digests are checked first, so a vector that is internally
 * inconsistent is reported as that rather than as a binding verdict. Capture
 * segments must also be named contiguously from seg-00000000: a gap would mean
 * a segment, and every frame chained through it, was removed.
 */
static bool check_binding(const char *dir, const char *vector, const mj_doc_t *doc,
                          const mj_node_t *exp)
{
    char path[512];
    snprintf(path, sizeof(path), "%s/manifest.cbor", dir);

    size_t   enc_len;
    uint8_t *encoded = read_file(path, &enc_len);
    if (encoded == NULL) {
        record_failure(vector, "cannot read manifest.cbor");
        return false;
    }

    static cairn_manifest_t m;
    static uint8_t scratch[CAIRN_MANIFEST_ENCODED_MAX];
    cairn_err_t err = cairn_manifest_decode(encoded, enc_len, &m, scratch, sizeof(scratch));
    free(encoded);
    if (err != CAIRN_OK) {
        record_failure(vector, "binding: manifest does not decode: %s", cairn_strerror(err));
        return false;
    }

    bool        want_match = mj_bool_or(mj_get(doc, exp, "match"), false);
    const char *want_field = mj_str_or(mj_get(doc, exp, "mismatched_field"), "");

    const char *bad_field = NULL;
    uint32_t    captures = 0;

    for (size_t i = 0; i < m.member_count && bad_field == NULL; i++) {
        const cairn_member_t *mem = &m.members[i];
        bool is_capture = strncmp(mem->name, "seg-", 4) == 0;

        if (is_capture) {
            char want_name[CAIRN_MAX_MEMBER_NAME];
            snprintf(want_name, sizeof(want_name), "seg-%08u.seg", (unsigned)captures);
            if (strcmp(mem->name, want_name) != 0) {
                bad_field = "segment_index";
                break;
            }
            captures++;
        } else if (strcmp(mem->name, "journal.seg") != 0) {
            continue;
        }

        snprintf(path, sizeof(path), "%s/%s", dir, mem->name);
        size_t   len;
        uint8_t *bytes = read_file(path, &len);
        if (bytes == NULL) {
            record_failure(vector, "binding: cannot read member %s", mem->name);
            return false;
        }

        uint8_t digest[32];
        cairn_sha256(bytes, len, digest);
        if (len != mem->length || memcmp(digest, mem->sha256, 32) != 0) {
            record_failure(vector, "member %s does not match its manifest digest: the "
                                   "vector is internally inconsistent", mem->name);
            free(bytes);
            return false;
        }

        cairn_segment_header_t h;
        err = cairn_parse_segment_header(bytes, len, &h, NULL);
        free(bytes);
        if (err != CAIRN_OK) {
            record_failure(vector, "member %s header: %s", mem->name, cairn_strerror(err));
            return false;
        }

        cairn_verify_segment_binding(&m, mem->name, &h, &bad_field);
    }

    if (want_match && bad_field != NULL) {
        record_failure(vector, "members should bind to the manifest, but %s disagrees",
                       bad_field);
        return false;
    }
    if (!want_match && bad_field == NULL) {
        record_failure(vector, "members bound to the manifest, but the vector expects "
                               "a mismatch on %s", want_field);
        return false;
    }
    if (!want_match && strcmp(bad_field, want_field) != 0) {
        record_failure(vector, "mismatch reported on %s, want %s", bad_field, want_field);
        return false;
    }
    return true;
}

/* ── receipt vectors ──────────────────────────────────────────────────────── */

static bool check_receipt(const char *dir, const char *vector,
                          const mj_doc_t *doc, const mj_node_t *exp)
{
    char path[512];
    snprintf(path, sizeof(path), "%s/receipt.cbor", dir);

    size_t len;
    uint8_t *encoded = read_file(path, &len);
    if (encoded == NULL) {
        record_failure(vector, "cannot read receipt.cbor");
        return false;
    }

    bool want_sig_valid = mj_bool_or(mj_get(doc, exp, "signature_valid"), false);
    bool want_ack = mj_bool_or(mj_get(doc, exp, "acknowledges_uploaded_root"), false);

    uint8_t pub[32], uploaded[32];
    if (!unhex(mj_str_or(mj_get(doc, exp, "server_public_key_hex"), ""), pub, 32)) {
        record_failure(vector, "server_public_key_hex is not 32 bytes of hex");
        free(encoded);
        return false;
    }
    if (!unhex(mj_str_or(mj_get(doc, exp, "uploaded_content_root_hex"), ""),
               uploaded, 32)) {
        record_failure(vector, "uploaded_content_root_hex is not 32 bytes of hex");
        free(encoded);
        return false;
    }

    cairn_receipt_t r;
    static uint8_t scratch[CAIRN_MANIFEST_ENCODED_MAX];
    cairn_err_t derr = cairn_receipt_decode(encoded, len, &r, scratch,
                                            sizeof(scratch));
    free(encoded);

    const char *want_parse = mj_str_or(mj_get(doc, exp, "parse_error"), "");
    if (want_parse[0] != '\0') {
        cairn_err_t want_err = CAIRN_OK;
        if (strcmp(want_parse, "non_canonical") == 0) want_err = CAIRN_ERR_NON_CANONICAL;
        else if (strcmp(want_parse, "truncated") == 0) want_err = CAIRN_ERR_TRUNCATED;
        else if (strcmp(want_parse, "unsupported_version") == 0 ||
                 strcmp(want_parse, "trailing_bytes") == 0) want_err = CAIRN_ERR_MALFORMED;
        if (want_err == CAIRN_OK || derr != want_err) {
            record_failure(vector, "receipt refused as %s, want %s", cairn_strerror(derr),
                           want_parse);
            return false;
        }
        return true;
    }

    if (derr != CAIRN_OK) {
        record_failure(vector, "cairn_receipt_decode: %s", cairn_strerror(derr));
        return false;
    }

    bool sig_ok = cairn_receipt_verify(&r, pub) == CAIRN_OK;
    if (want_sig_valid && !sig_ok) {
        record_failure(vector, "signature should verify");
        return false;
    }
    if (!want_sig_valid && sig_ok) {
        record_failure(vector, "signature verified but the vector expects failure");
        return false;
    }

    bool ack_ok = cairn_receipt_verify_acknowledges(&r, pub, uploaded) == CAIRN_OK;
    if (want_ack && !ack_ok) {
        record_failure(vector, "receipt should acknowledge the upload");
        return false;
    }
    if (!want_ack && ack_ok) {
        record_failure(vector,
                       "receipt accepted as an acknowledgement but the vector "
                       "expects rejection");
        return false;
    }

    /* The server seed is fixed too, so the pinned key must be derivable. */
    uint8_t seed[32], derived[32];
    memcpy(seed, SERVER_KEY_SEED, 32);
    cairn_ed25519_public_from_seed(seed, derived);
    if (want_sig_valid && memcmp(derived, pub, 32) != 0) {
        record_failure(vector, "server key derived from the vector seed does not "
                               "match server_public_key_hex");
        return false;
    }

    return true;
}

/* ── merkle vectors ───────────────────────────────────────────────────────── */

static bool check_merkle(const char *dir, const char *vector,
                         const mj_doc_t *doc, const mj_node_t *exp)
{
    const char *want_root_hex = mj_str_or(mj_get(doc, exp, "root_hex"), "");
    const mj_node_t *leaves = mj_get(doc, exp, "leaves_hex");

    /* Leaves present (possibly an empty list): check tree construction. */
    if (leaves != NULL && !mj_is_null(leaves)) {
        size_t count = mj_len(doc, leaves);
        if (count > CAIRN_MAX_MEMBERS) {
            record_failure(vector, "%zu leaves exceeds CAIRN_MAX_MEMBERS", count);
            return false;
        }

        uint8_t nodes[CAIRN_MAX_MEMBERS][32];
        for (size_t i = 0; i < count; i++) {
            const char *h = mj_str_or(mj_at(doc, leaves, i), "");
            if (!unhex(h, nodes[i], 32)) {
                record_failure(vector, "leaf %zu is not 32 bytes of hex", i);
                return false;
            }
        }

        uint8_t root[32];
        char got[65];
        cairn_merkle_root(nodes, count, root);
        tohex(root, 32, got);

        if (strcmp(got, want_root_hex) != 0) {
            record_failure(vector, "root = %s, want %s", got, want_root_hex);
            return false;
        }
        return true;
    }

    /* Otherwise it is a content-root vector described by members.json. */
    char path[512];
    snprintf(path, sizeof(path), "%s/members.json", dir);

    size_t raw_len;
    uint8_t *raw = read_file(path, &raw_len);
    if (raw == NULL) {
        record_failure(vector, "cannot read members.json");
        return false;
    }

    mj_doc_t mdoc;
    bool parsed = mj_parse(&mdoc, (const char *)raw);
    free(raw);
    if (!parsed) {
        record_failure(vector, "parse members.json: %s", mdoc.error);
        return false;
    }

    const mj_node_t *arr = mj_root(&mdoc);
    size_t count = mj_len(&mdoc, arr);
    if (count > CAIRN_MAX_MEMBERS) {
        record_failure(vector, "%zu members exceeds CAIRN_MAX_MEMBERS", count);
        return false;
    }

    cairn_member_t members[CAIRN_MAX_MEMBERS];
    memset(members, 0, sizeof(members));

    for (size_t i = 0; i < count; i++) {
        const mj_node_t *d = mj_at(&mdoc, arr, i);
        const char *name = mj_str_or(mj_get(&mdoc, d, "name"), "");

        if (strlen(name) + 1 > CAIRN_MAX_MEMBER_NAME) {
            record_failure(vector, "member name %s is too long", name);
            return false;
        }
        snprintf(members[i].name, CAIRN_MAX_MEMBER_NAME, "%s", name);

        members[i].length = (uint64_t)mj_num_or(mj_get(&mdoc, d, "length"), 0);
        if (!unhex(mj_str_or(mj_get(&mdoc, d, "sha256_hex"), ""),
                   members[i].sha256, 32)) {
            record_failure(vector, "member %zu sha256_hex is not 32 bytes of hex", i);
            return false;
        }
    }

    uint8_t root[32];
    char got[65];
    cairn_err_t err = cairn_content_root(members, count, root);
    if (err != CAIRN_OK) {
        record_failure(vector, "cairn_content_root: %s", cairn_strerror(err));
        return false;
    }
    tohex(root, 32, got);

    if (strcmp(got, want_root_hex) != 0) {
        record_failure(vector, "content root = %s, want %s", got, want_root_hex);
        return false;
    }

    /*
     * Order independence: a permuted input must yield the same root. Identity
     * depends on content, not on the order a directory happened to be walked in.
     */
    if (count > 2) {
        cairn_member_t permuted[CAIRN_MAX_MEMBERS];
        permuted[0] = members[2];
        permuted[1] = members[0];
        permuted[2] = members[1];
        for (size_t i = 3; i < count; i++) permuted[i] = members[i];

        uint8_t proot[32];
        err = cairn_content_root(permuted, count, proot);
        if (err != CAIRN_OK) {
            record_failure(vector, "cairn_content_root (permuted): %s",
                           cairn_strerror(err));
            return false;
        }
        if (memcmp(proot, root, 32) != 0) {
            record_failure(vector, "permuted members produced a different "
                                   "content root");
            return false;
        }
    }

    return true;
}


/* ── policy snapshot ──────────────────────────────────────────────────────── */

/*
 * The committed payload must decode to the expected values and re-encode to
 * exactly the committed bytes.
 *
 * The re-encode is the point: two bundles captured under identical policy must
 * have byte-identical snapshots, which is what lets a reader group them without
 * trusting the version number.
 */
static bool check_policy(const char *dir, const char *vector,
                         const mj_doc_t *doc, const mj_node_t *exp)
{
    char path[512];
    snprintf(path, sizeof(path), "%s/policy.cbor", dir);

    size_t len;
    uint8_t *raw = read_file(path, &len);
    if (raw == NULL) {
        record_failure(vector, "cannot read policy.cbor");
        return false;
    }

    cairn_policy_t p;
    if (!cairn_policy_decode(raw, len, &p)) {
        record_failure(vector, "policy.cbor does not decode");
        free(raw);
        return false;
    }

    struct {
        const char *key;
        uint64_t    got;
    } fields[] = {
        { "policy_version",           p.policy_version },
        { "gnss_period_ms",           p.gnss_period_ms },
        { "imu_window_ms",            p.imu_window_ms },
        { "obd_period_ms",            p.obd_period_ms },
        { "health_period_ms",         p.health_period_ms },
        { "start_score_threshold_e2", p.start_score_threshold_e2 },
        { "stop_score_threshold_e2",  p.stop_score_threshold_e2 },
        { "start_dwell_ms",           p.start_dwell_ms },
        { "stop_dwell_ms",            p.stop_dwell_ms },
        { "motion_accel_rms_mg",      p.motion_accel_rms_mg },
        { "motion_speed_cmps",        p.motion_speed_cmps },
        { "preroll_window_ms",        p.preroll_window_ms },
        { "preroll_ring_samples",     p.preroll_ring_samples },
        { "segment_max_bytes",        p.segment_max_bytes },
    };

    bool ok = true;
    for (size_t i = 0; i < sizeof(fields) / sizeof(fields[0]); i++) {
        uint64_t want = (uint64_t)mj_num_or(mj_get(doc, exp, fields[i].key), -1);
        if (fields[i].got != want) {
            record_failure(vector, "%s = %llu, want %llu", fields[i].key,
                           (unsigned long long)fields[i].got,
                           (unsigned long long)want);
            ok = false;
        }
    }

    bool want_adaptive = mj_bool_or(mj_get(doc, exp, "adaptive_sampling"), false);
    if (p.adaptive_sampling != want_adaptive) {
        record_failure(vector, "adaptive_sampling = %d, want %d",
                       (int)p.adaptive_sampling, (int)want_adaptive);
        ok = false;
    }

    uint8_t reencoded[512];
    size_t  rlen = cairn_policy_encode(&p, reencoded, sizeof(reencoded));

    if (rlen != len) {
        record_failure(vector, "re-encoding produced %zu bytes, want the "
                               "committed %zu", rlen, len);
        ok = false;
    } else if (memcmp(reencoded, raw, len) != 0) {
        /* Same length, different bytes — report where, since that is the only
         * useful thing to know and the length alone would read as a
         * contradiction. */
        size_t at = 0;
        while (at < len && reencoded[at] == raw[at]) at++;
        record_failure(vector, "re-encoding differs from the committed bytes at "
                               "offset %zu (got 0x%02x, want 0x%02x) — this "
                               "implementation does not produce byte-identical "
                               "output", at, (unsigned)reencoded[at],
                       (unsigned)raw[at]);
        ok = false;
    }

    free(raw);
    return ok;
}

/* ── trip events ──────────────────────────────────────────────────────────── */

static size_t  g_event_count;
static uint8_t g_event_types[32];
static uint8_t g_event_detail_len[32];
static int32_t g_event_lat[32];
static int32_t g_event_lon[32];
static char    g_event_detail[32][64];

static bool event_collect_cb(const cairn_frame_t *f, void *user)
{
    (void)user;

    if (f->record_type != CAIRN_REC_TRIP_EVENT) return true;
    if (g_event_count >= 32 || f->payload_len < 12) return true;

    size_t i = g_event_count++;
    g_event_types[i]      = f->payload[0];
    g_event_detail_len[i] = f->payload[1];
    g_event_lat[i] = (int32_t)get_u32_le(f->payload + 4);
    g_event_lon[i] = (int32_t)get_u32_le(f->payload + 8);

    size_t dlen = f->payload[1];
    if (dlen > sizeof(g_event_detail[0]) - 1) dlen = sizeof(g_event_detail[0]) - 1;
    memcpy(g_event_detail[i], f->payload + 12, dlen);
    g_event_detail[i][dlen] = '\0';

    return true;
}

static bool check_events(const char *dir, const char *vector,
                         const mj_doc_t *doc, const mj_node_t *exp)
{
    char path[512];
    snprintf(path, sizeof(path), "%s/segment.bin", dir);

    size_t len;
    uint8_t *bytes = read_file(path, &len);
    if (bytes == NULL) {
        record_failure(vector, "cannot read segment.bin");
        return false;
    }

    g_event_count = 0;

    cairn_scan_result_t res;
    cairn_scan_state_t state = { 0, 0 };
    /* Payloads are sealed, so reading them takes the key. */
    cairn_scan_opts_t opts = { cairn_root_key_provider, &g_root, event_collect_cb, NULL };
    cairn_err_t err = cairn_scan_segment(bytes, len, state, &opts, &res);
    free(bytes);

    if (err != CAIRN_OK) {
        record_failure(vector, "scan failed: %s", cairn_strerror(err));
        return false;
    }

    const mj_node_t *list = mj_get(doc, exp, "events");
    size_t want_count = mj_len(doc, list);

    if (g_event_count != want_count) {
        record_failure(vector, "found %zu events, want %zu", g_event_count,
                       want_count);
        return false;
    }

    for (size_t i = 0; i < want_count; i++) {
        const mj_node_t *e = mj_at(doc, list, i);

        uint8_t want_type = (uint8_t)mj_num_or(mj_get(doc, e, "event_type"), -1);
        if (g_event_types[i] != want_type) {
            record_failure(vector, "event %zu type = %u, want %u", i,
                           (unsigned)g_event_types[i], (unsigned)want_type);
            return false;
        }

        /*
         * The name must match too. An unknown type is expected to be *named* as
         * unknown rather than discarded, so a newer device's events still
         * appear with their position and timing intact.
         */
        const char *want_name = mj_str_or(mj_get(doc, e, "event_type_name"), "");
        const char *got_name = cairn_event_type_name(g_event_types[i]);
        bool known = strcmp(got_name, "UNKNOWN_EVENT") != 0;
        bool want_known = strncmp(want_name, "UNKNOWN", 7) != 0;

        if (known != want_known) {
            record_failure(vector, "event %zu named %s, want %s", i, got_name,
                           want_name);
            return false;
        }
        if (known && strcmp(got_name, want_name) != 0) {
            record_failure(vector, "event %zu name = %s, want %s", i, got_name,
                           want_name);
            return false;
        }

        int32_t want_lat = (int32_t)mj_num_or(mj_get(doc, e, "lat_e7"), 0);
        int32_t want_lon = (int32_t)mj_num_or(mj_get(doc, e, "lon_e7"), 0);
        if (g_event_lat[i] != want_lat || g_event_lon[i] != want_lon) {
            record_failure(vector, "event %zu position = (%ld, %ld), want "
                                   "(%ld, %ld)", i, (long)g_event_lat[i],
                           (long)g_event_lon[i], (long)want_lat, (long)want_lon);
            return false;
        }

        const char *want_detail = mj_str_or(mj_get(doc, e, "detail"), "");
        if (strcmp(g_event_detail[i], want_detail) != 0) {
            record_failure(vector, "event %zu detail = \"%s\", want \"%s\"", i,
                           g_event_detail[i], want_detail);
            return false;
        }
    }

    return true;
}

/* ── degraded-state bitmap ────────────────────────────────────────────────── */

static size_t  g_health_count;
static uint8_t g_health_states[32];

static bool health_collect_cb(const cairn_frame_t *f, void *user)
{
    (void)user;

    if (f->record_type == CAIRN_REC_DEVICE_HEALTH && f->payload_len >= 13 &&
        g_health_count < 32) {
        g_health_states[g_health_count++] = f->payload[12];
    }
    return true;
}

static bool check_health(const char *dir, const char *vector,
                         const mj_doc_t *doc, const mj_node_t *exp)
{
    char path[512];
    snprintf(path, sizeof(path), "%s/segment.bin", dir);

    size_t len;
    uint8_t *bytes = read_file(path, &len);
    if (bytes == NULL) {
        record_failure(vector, "cannot read segment.bin");
        return false;
    }

    g_health_count = 0;

    cairn_scan_result_t res;
    cairn_scan_state_t state = { 0, 0 };
    /* Payloads are sealed, so reading them takes the key. */
    cairn_scan_opts_t opts = { cairn_root_key_provider, &g_root, health_collect_cb, NULL };
    cairn_err_t err = cairn_scan_segment(bytes, len, state, &opts, &res);
    free(bytes);

    if (err != CAIRN_OK) {
        record_failure(vector, "scan failed: %s", cairn_strerror(err));
        return false;
    }

    const mj_node_t *list = mj_get(doc, exp, "records");
    size_t want_count = mj_len(doc, list);

    if (g_health_count != want_count) {
        record_failure(vector, "found %zu health records, want %zu",
                       g_health_count, want_count);
        return false;
    }

    for (size_t i = 0; i < want_count; i++) {
        const mj_node_t *r = mj_at(doc, list, i);

        uint8_t want_state = (uint8_t)mj_num_or(mj_get(doc, r, "health_state"), -1);
        if (g_health_states[i] != want_state) {
            record_failure(vector, "health record %zu state = 0x%02x, want "
                                   "0x%02x", i, (unsigned)g_health_states[i],
                           (unsigned)want_state);
            return false;
        }

        /* Every expected name must appear, including a reserved bit rendered
         * as hex rather than masked away. */
        const mj_node_t *names = mj_get(doc, r, "names");
        char rendered[256];
        cairn_health_state_names(g_health_states[i], rendered, sizeof(rendered));

        for (size_t j = 0; j < mj_len(doc, names); j++) {
            const char *want = mj_str_or(mj_at(doc, names, j), "");
            if (strstr(rendered, want) == NULL) {
                record_failure(vector, "health record %zu renders \"%s\", "
                                       "missing %s", i, rendered, want);
                return false;
            }
        }
    }

    return true;
}

/* ── OBD_EXTENDED ────────────────────────────────────────────────────────── */

typedef struct {
    uint16_t map_kpa;
    uint16_t maf_cgps;
    uint16_t lambda_e4;
    uint16_t abs_load_raw;
    uint8_t  baro_kpa;
    int8_t   ambient_temp_c;
    int8_t   fuel_trim_short_pct;
    int8_t   fuel_trim_long_pct;
    uint32_t pids_requested;
    uint32_t pids_answered;
    uint16_t poll_cadence_ms;
} obd_ext_raw_t;

#define MAX_OBD_EXT_RECORDS 16
static size_t       g_obd_ext_count;
static obd_ext_raw_t g_obd_ext[MAX_OBD_EXT_RECORDS];

static uint16_t le_u16(const uint8_t *p) {
    return (uint16_t)p[0] | ((uint16_t)p[1] << 8);
}

static uint32_t le_u32(const uint8_t *p) {
    return (uint32_t)p[0] | ((uint32_t)p[1] << 8) |
           ((uint32_t)p[2] << 16) | ((uint32_t)p[3] << 24);
}

static bool obd_ext_collect_cb(const cairn_frame_t *f, void *user)
{
    (void)user;

    if (f->record_type == CAIRN_REC_OBD_EXTENDED && f->payload_len >= 24 &&
        g_obd_ext_count < MAX_OBD_EXT_RECORDS) {
        const uint8_t *p = f->payload;
        obd_ext_raw_t *r = &g_obd_ext[g_obd_ext_count++];
        r->map_kpa            = le_u16(p + 0);
        r->maf_cgps           = le_u16(p + 2);
        r->lambda_e4          = le_u16(p + 4);
        r->abs_load_raw       = le_u16(p + 6);
        r->baro_kpa           = p[8];
        r->ambient_temp_c     = (int8_t)p[9];
        r->fuel_trim_short_pct = (int8_t)p[10];
        r->fuel_trim_long_pct = (int8_t)p[11];
        r->pids_requested     = le_u32(p + 12);
        r->pids_answered      = le_u32(p + 16);
        r->poll_cadence_ms    = le_u16(p + 20);
    }
    return true;
}

static bool check_obd_ext(const char *dir, const char *vector,
                           const mj_doc_t *doc, const mj_node_t *exp)
{
    char path[512];
    snprintf(path, sizeof(path), "%s/segment.bin", dir);

    size_t len;
    uint8_t *bytes = read_file(path, &len);
    if (bytes == NULL) {
        record_failure(vector, "cannot read segment.bin");
        return false;
    }

    g_obd_ext_count = 0;

    cairn_scan_result_t res;
    cairn_scan_state_t state = { 0, 0 };
    /* Payloads are sealed, so reading them takes the key. */
    cairn_scan_opts_t opts = { cairn_root_key_provider, &g_root, obd_ext_collect_cb, NULL };
    cairn_err_t err = cairn_scan_segment(bytes, len, state, &opts, &res);
    free(bytes);

    if (err != CAIRN_OK) {
        record_failure(vector, "scan failed: %s", cairn_strerror(err));
        return false;
    }

    const mj_node_t *list = mj_get(doc, exp, "records");
    size_t want_count = mj_len(doc, list);

    if (g_obd_ext_count != want_count) {
        record_failure(vector, "found %zu OBD_EXTENDED records, want %zu",
                       g_obd_ext_count, want_count);
        return false;
    }

    for (size_t i = 0; i < want_count; i++) {
        const mj_node_t *r = mj_at(doc, list, i);
        const obd_ext_raw_t *got = &g_obd_ext[i];

#define CHECK_U16(field, json_key) do { \
    const mj_node_t *n = mj_get(doc, r, json_key); \
    if (n != NULL && !mj_is_null(n)) { \
        uint16_t want = (uint16_t)mj_num_or(n, -1); \
        if (got->field != want) { \
            record_failure(vector, "record %zu " json_key " = %u, want %u", \
                           i, (unsigned)got->field, (unsigned)want); \
            return false; \
        } \
    } \
} while (0)

#define CHECK_U32(field, json_key) do { \
    uint32_t want = (uint32_t)mj_num_or(mj_get(doc, r, json_key), -1); \
    if (got->field != want) { \
        record_failure(vector, "record %zu " json_key " = %u, want %u", \
                       i, (unsigned)got->field, (unsigned)want); \
        return false; \
    } \
} while (0)

#define CHECK_I8(field, json_key) do { \
    const mj_node_t *n = mj_get(doc, r, json_key); \
    if (n != NULL && !mj_is_null(n)) { \
        int8_t want = (int8_t)(int)mj_num_or(n, -999); \
        if (got->field != want) { \
            record_failure(vector, "record %zu " json_key " = %d, want %d", \
                           i, (int)got->field, (int)want); \
            return false; \
        } \
    } \
} while (0)

#define CHECK_U8(field, json_key) do { \
    const mj_node_t *n = mj_get(doc, r, json_key); \
    if (n != NULL && !mj_is_null(n)) { \
        uint8_t want = (uint8_t)mj_num_or(n, -1); \
        if (got->field != want) { \
            record_failure(vector, "record %zu " json_key " = %u, want %u", \
                           i, (unsigned)got->field, (unsigned)want); \
            return false; \
        } \
    } \
} while (0)

        CHECK_U16(map_kpa,            "map_kpa");
        CHECK_U16(maf_cgps,           "maf_cgps");
        CHECK_U16(lambda_e4,          "lambda_e4");
        CHECK_U16(abs_load_raw,       "abs_load_raw");
        CHECK_U8(baro_kpa,            "baro_kpa");
        CHECK_I8(ambient_temp_c,      "ambient_temp_c");
        CHECK_I8(fuel_trim_short_pct, "fuel_trim_short_pct");
        CHECK_I8(fuel_trim_long_pct,  "fuel_trim_long_pct");
        CHECK_U32(pids_requested,     "pids_requested");
        CHECK_U32(pids_answered,      "pids_answered");
        CHECK_U16(poll_cadence_ms,    "poll_cadence_ms");

        bool want_saturated = mj_bool_or(mj_get(doc, r, "map_saturated"), false);
        bool got_saturated  = (got->map_kpa == 255);
        if (got_saturated != want_saturated) {
            record_failure(vector, "record %zu map_saturated = %d, want %d",
                           i, got_saturated, want_saturated);
            return false;
        }

#undef CHECK_U16
#undef CHECK_U32
#undef CHECK_I8
#undef CHECK_U8
    }

    return true;
}

/* ── OTA update descriptor ────────────────────────────────────────────────── */

static bool check_update(const char *dir, const char *vector,
                         const mj_doc_t *doc, const mj_node_t *exp)
{
    char path[512];

    snprintf(path, sizeof(path), "%s/descriptor.cbor", dir);
    size_t enc_len;
    uint8_t *encoded = read_file(path, &enc_len);

    snprintf(path, sizeof(path), "%s/descriptor.sig", dir);
    size_t sig_len;
    uint8_t *sig = read_file(path, &sig_len);

    if (encoded == NULL || sig == NULL || sig_len != 64) {
        record_failure(vector, "descriptor or signature is missing");
        free(encoded);
        free(sig);
        return false;
    }

    uint8_t pub[32];
    if (!unhex(mj_str_or(mj_get(doc, exp, "update_public_key_hex"), ""), pub, 32)) {
        record_failure(vector, "update_public_key_hex is not 32 bytes of hex");
        free(encoded);
        free(sig);
        return false;
    }

    bool want_valid = mj_bool_or(mj_get(doc, exp, "signature_valid"), false);

    cairn_update_descriptor_t d;
    static uint8_t scratch[512];
    cairn_err_t err = cairn_update_verify(encoded, enc_len, sig, pub, &d,
                                          scratch, sizeof(scratch));

    free(encoded);
    free(sig);

    if (want_valid && err != CAIRN_OK) {
        record_failure(vector, "descriptor should verify: %s",
                       cairn_strerror(err));
        return false;
    }
    if (!want_valid) {
        if (err == CAIRN_OK) {
            record_failure(vector, "descriptor verified but the vector expects "
                                   "failure");
            return false;
        }
        return true;
    }

    const char *want_version = mj_str_or(mj_get(doc, exp, "firmware_version"), "");
    if (strcmp(d.firmware_version, want_version) != 0) {
        record_failure(vector, "firmware_version = \"%s\", want \"%s\"",
                       d.firmware_version, want_version);
        return false;
    }

    const char *want_min = mj_str_or(mj_get(doc, exp, "min_firmware_version"), "");
    if (strcmp(d.min_firmware_version, want_min) != 0) {
        record_failure(vector, "min_firmware_version = \"%s\", want \"%s\"",
                       d.min_firmware_version, want_min);
        return false;
    }

    uint32_t want_len = (uint32_t)mj_num_or(mj_get(doc, exp, "image_length"), 0);
    if (d.image_length != want_len) {
        record_failure(vector, "image_length = %u, want %u",
                       (unsigned)d.image_length, (unsigned)want_len);
        return false;
    }

    uint8_t want_digest[32];
    if (!unhex(mj_str_or(mj_get(doc, exp, "image_sha256_hex"), ""), want_digest, 32)) {
        record_failure(vector, "image_sha256_hex is not 32 bytes of hex");
        return false;
    }
    if (memcmp(d.image_sha256, want_digest, 32) != 0) {
        record_failure(vector, "image_sha256 does not match");
        return false;
    }

    return true;
}

/* ── primitive known answers ──────────────────────────────────────────────── */

/*
 * Each primitive against its own published vector, before any Cairn vector.
 *
 * The Cairn vectors exercise all of these together, so a failure there says
 * only that something is wrong. These say which layer: a wrong HChaCha20 and a
 * wrong Poly1305 produce the same "keyed scan failed" on a segment but fail
 * different checks here.
 */
static int g_kat_checked, g_kat_passed;

static bool kat_hex(const char *name, const uint8_t *got, size_t len, const char *want)
{
    g_kat_checked++;
    char hex[512];
    tohex(got, len, hex);
    if (strcmp(hex, want) != 0) {
        record_failure(name, "got %s, want %s", hex, want);
        return false;
    }
    g_kat_passed++;
    return true;
}

static void run_known_answers(void)
{
    /* draft-irtf-cfrg-xchacha-03 §2.2.1. */
    {
        uint8_t key[32], in[16], out[32];
        for (int i = 0; i < 32; i++) key[i] = (uint8_t)i;
        unhex("000000090000004a0000000031415927", in, sizeof(in));
        cairn_hchacha20(key, in, out);
        kat_hex("kat hchacha20", out, sizeof(out),
                "82413b4227b27bfed30e42508a877d73a0f9e4d58a74a853c12ec41326d3ecdc");
    }

    /* draft-irtf-cfrg-xchacha-03 §A.3.1, the AEAD_XChaCha20_Poly1305 vector. */
    {
        static const char PT[] =
            "Ladies and Gentlemen of the class of '99: If I could offer you only "
            "one tip for the future, sunscreen would be it.";
        const size_t len = sizeof(PT) - 1;

        uint8_t key[32], nonce[24], aad[12], ct[sizeof(PT)], tag[16], back[sizeof(PT)];
        unhex("808182838485868788898a8b8c8d8e8f909192939495969798999a9b9c9d9e9f", key,
              sizeof(key));
        unhex("404142434445464748494a4b4c4d4e4f5051525354555657", nonce, sizeof(nonce));
        unhex("50515253c0c1c2c3c4c5c6c7", aad, sizeof(aad));

        cairn_xchacha20poly1305_seal(key, nonce, aad, sizeof(aad), (const uint8_t *)PT,
                                     len, ct, tag);
        kat_hex("kat xchacha20poly1305 ciphertext", ct, len,
                "bd6d179d3e83d43b9576579493c0e939572a1700252bfaccbed2902c21396cbb"
                "731c7f1b0b4aa6440bf3a82f4eda7e39ae64c6708c54c216cb96b72e1213b452"
                "2f8c9ba40db5d945b11b69b982c1bb9e3f3fac2bc369488f76b2383565d3fff9"
                "21f9664c97637da9768812f615c68b13b52e");
        kat_hex("kat xchacha20poly1305 tag", tag, sizeof(tag),
                "c0875924c1c7987947deafd8780acf49");

        /* Round trip, and a one-bit change anywhere must be refused. */
        g_kat_checked++;
        bool opened = cairn_xchacha20poly1305_open(key, nonce, aad, sizeof(aad), ct, len,
                                                   tag, back) &&
                      memcmp(back, PT, len) == 0;
        ct[17] ^= 0x01;
        bool flipped_ct = cairn_xchacha20poly1305_open(key, nonce, aad, sizeof(aad), ct,
                                                       len, tag, back);
        ct[17] ^= 0x01;
        aad[0] ^= 0x80;
        bool flipped_aad = cairn_xchacha20poly1305_open(key, nonce, aad, sizeof(aad), ct,
                                                        len, tag, back);
        aad[0] ^= 0x80;
        if (opened && !flipped_ct && !flipped_aad) {
            g_kat_passed++;
        } else {
            record_failure("kat xchacha20poly1305 open",
                           "round trip %d, flipped ciphertext accepted %d, flipped "
                           "AAD accepted %d", opened, flipped_ct, flipped_aad);
        }

        /* Two-part AAD must authenticate exactly as its concatenation. */
        uint8_t tag2[16];
        cairn_xchacha20poly1305_seal2(key, nonce, aad, 5, aad + 5, sizeof(aad) - 5,
                                      (const uint8_t *)PT, len, back, tag2);
        kat_hex("kat xchacha20poly1305 split AAD", tag2, sizeof(tag2),
                "c0875924c1c7987947deafd8780acf49");
    }

    /* RFC 5869 A.1 and A.3 (the zero-length salt and info case). */
    {
        uint8_t ikm[22], salt[13], info[10], okm[42];
        memset(ikm, 0x0b, sizeof(ikm));
        unhex("000102030405060708090a0b0c", salt, sizeof(salt));
        unhex("f0f1f2f3f4f5f6f7f8f9", info, sizeof(info));

        cairn_hkdf_sha256(salt, sizeof(salt), ikm, sizeof(ikm), info, sizeof(info), okm,
                          sizeof(okm));
        kat_hex("kat hkdf rfc5869 A.1", okm, sizeof(okm),
                "3cb25f25faacd57a90434f64d0362f2a2d2d0a90cf1a5a4c5db02d56ecc4c5bf"
                "34007208d5b887185865");

        cairn_hkdf_sha256(NULL, 0, ikm, sizeof(ikm), NULL, 0, okm, sizeof(okm));
        kat_hex("kat hkdf rfc5869 A.3", okm, sizeof(okm),
                "8da4e775a563c18f715f802a063c5a31b8a11f5c5ee1879ec3454e5f3c738d2d"
                "9d201395faa4b61a96c8");
    }
}

/*
 * keys.json: the public test root, plus a worked HKDF example for the vector
 * identities. The worked example is checked here as well as through the
 * segment vectors, because it pins the segment key from identities alone with
 * no header encoding in the way.
 */
static bool load_keys(const char *root)
{
    char path[600];
    snprintf(path, sizeof(path), "%s/keys.json", root);

    size_t   len;
    uint8_t *raw = read_file(path, &len);
    if (raw == NULL) {
        record_failure("keys.json", "cannot read %s", path);
        return false;
    }

    static mj_doc_t doc;
    bool parsed = mj_parse(&doc, (const char *)raw);
    free(raw);
    if (!parsed) {
        record_failure("keys.json", "unparseable: %s", doc.error);
        return false;
    }

    const mj_node_t *k = mj_root(&doc);
    if (!unhex(mj_str_or(mj_get(&doc, k, "root_key_hex"), ""), g_root.root, 32)) {
        record_failure("keys.json", "root_key_hex is not 32 bytes of hex");
        return false;
    }
    g_root.version = (uint32_t)mj_num_or(mj_get(&doc, k, "storage_key_version"), 0);
    g_have_root = true;

    const char *suite = mj_str_or(mj_get(&doc, k, "encryption_suite"), "");
    if (strcmp(suite, CAIRN_ENCRYPTION_SUITE_V1) != 0) {
        record_failure("keys.json", "encryption_suite %s, this implementation is %s",
                       suite, CAIRN_ENCRYPTION_SUITE_V1);
    }

    cairn_segment_header_t h;
    memset(&h, 0, sizeof(h));
    bool ids = unhex(mj_str_or(mj_get(&doc, k, "device_id_hex"), ""), h.device_id, 16) &&
               unhex(mj_str_or(mj_get(&doc, k, "boot_id_hex"), ""), h.boot_id, 16) &&
               unhex(mj_str_or(mj_get(&doc, k, "vehicle_id_hex"), ""), h.vehicle_id, 16) &&
               unhex(mj_str_or(mj_get(&doc, k, "assignment_id_hex"), ""),
                     h.assignment_id, 16);
    if (!ids) {
        record_failure("keys.json", "vector identities are not 16 bytes of hex each");
        return true;
    }

    const mj_node_t *ex = mj_get(&doc, k, "worked_example");
    uint8_t key[32];

    h.segment_index = 0;
    cairn_derive_segment_key(g_root.root, &h, key);
    kat_hex("keys.json worked example: capture segment 0", key, sizeof(key),
            mj_str_or(mj_get(&doc, ex, "capture_segment_0_key_hex"), ""));

    h.segment_index = CAIRN_JOURNAL_SEGMENT_INDEX;
    cairn_derive_segment_key(g_root.root, &h, key);
    kat_hex("keys.json worked example: journal", key, sizeof(key),
            mj_str_or(mj_get(&doc, ex, "journal_key_hex"), ""));

    return true;
}

/* ── driver ───────────────────────────────────────────────────────────────── */

static int compare_names(const void *a, const void *b)
{
    const char *const *x = a;
    const char *const *y = b;
    return strcmp(*x, *y);
}

static void run_vector(const char *root, const char *name)
{
    char dir[512], path[600];
    snprintf(dir, sizeof(dir), "%s/%s", root, name);
    snprintf(path, sizeof(path), "%s/expected.json", dir);

    size_t raw_len;
    uint8_t *raw = read_file(path, &raw_len);
    if (raw == NULL) {
        g_checked++;
        record_failure(name, "no expected.json");
        return;
    }

    static mj_doc_t doc;
    bool parsed = mj_parse(&doc, (const char *)raw);
    free(raw);

    g_checked++;
    if (!parsed) {
        record_failure(name, "unparseable expected.json: %s", doc.error);
        return;
    }

    const mj_node_t *exp = mj_root(&doc);
    bool ok;

    /* Multi-segment vectors carry their own shape. */
    const mj_node_t *segments = mj_get(&doc, exp, "segments");
    const mj_node_t *scan     = mj_get(&doc, exp, "scan");
    const mj_node_t *keyed    = mj_get(&doc, exp, "keyed");
    const mj_node_t *header   = mj_get(&doc, exp, "header");
    const mj_node_t *manifest = mj_get(&doc, exp, "manifest");
    const mj_node_t *binding  = mj_get(&doc, exp, "binding");
    const mj_node_t *receipt  = mj_get(&doc, exp, "receipt");
    const mj_node_t *merkle   = mj_get(&doc, exp, "merkle");
    const mj_node_t *policy   = mj_get(&doc, exp, "policy");
    const mj_node_t *events   = mj_get(&doc, exp, "events");
    const mj_node_t *health   = mj_get(&doc, exp, "health");
    const mj_node_t *update   = mj_get(&doc, exp, "update");
    const mj_node_t *obd_ext  = mj_get(&doc, exp, "obd_ext");

    /*
     * Every segment vector states a keyed verdict as well as a structural one.
     * One that does not is a vector this runner would silently half-check, so
     * it fails rather than passing on the structural verdict alone.
     */
    if (scan != NULL && keyed == NULL) {
        record_failure(name, "segment vector has no keyed verdict");
        return;
    }

    if (segments != NULL && mj_len(&doc, segments) > 0) {
        ok = check_multi_segment(dir, name, &doc, exp, segments);
    } else if (policy != NULL) {
        ok = check_policy(dir, name, &doc, policy);
    } else if (update != NULL) {
        ok = check_update(dir, name, &doc, update);
    } else if (events != NULL) {
        /* These carry a scan too, so the frames are walked and the payloads
         * checked against the same bytes. */
        ok = check_scan(dir, name, &doc, scan, keyed) &&
             check_events(dir, name, &doc, events);
    } else if (health != NULL) {
        ok = check_scan(dir, name, &doc, scan, keyed) &&
             check_health(dir, name, &doc, health);
    } else if (obd_ext != NULL) {
        ok = check_scan(dir, name, &doc, scan, keyed) &&
             check_obd_ext(dir, name, &doc, obd_ext);
    } else if (scan != NULL) {
        ok = check_scan(dir, name, &doc, scan, keyed);
    } else if (header != NULL) {
        ok = check_header(dir, name, &doc, header);
    } else if (manifest != NULL) {
        ok = check_manifest(dir, name, &doc, manifest);
        if (binding != NULL) ok = check_binding(dir, name, &doc, binding) && ok;
    } else if (receipt != NULL) {
        ok = check_receipt(dir, name, &doc, receipt);
    } else if (merkle != NULL) {
        ok = check_merkle(dir, name, &doc, merkle);
    } else {
        if (g_skipped_count < 64) {
            snprintf(g_skipped[g_skipped_count++], 128, "%s", name);
        }
        g_checked--;
        return;
    }

    if (ok) g_passed++;
}

int main(int argc, char **argv)
{
    if (argc < 2) {
        fprintf(stderr, "usage: %s <format-v3 vectors directory>   (CAIRN_CONTRACTS/format/v3/vectors; "
                        "the Makefile passes it)\n", argv[0]);
        return 2;
    }
    const char *root = argv[1];

    run_known_answers();
    load_keys(root);

    /* The vector list is derived from the directory rather than hard-coded, so
     * a newly generated vector is picked up without editing this file. */
    char cmd[1024];
    snprintf(cmd, sizeof(cmd), "ls -1 '%s'", root);

    FILE *p = popen(cmd, "r");
    if (p == NULL) {
        fprintf(stderr, "cannot list %s\n", root);
        return 2;
    }

    static char names[256][128];
    const char *order[256];
    int count = 0;

    while (count < 256 && fgets(names[count], sizeof(names[count]), p) != NULL) {
        char *nl = strchr(names[count], '\n');
        if (nl != NULL) *nl = '\0';
        if (names[count][0] == '\0') continue;
        if (strstr(names[count], ".") != NULL) continue; /* README.md, keys.json */
        order[count] = names[count];
        count++;
    }
    pclose(p);

    if (count == 0) {
        fprintf(stderr, "no vectors found under %s\n", root);
        return 2;
    }

    qsort(order, (size_t)count, sizeof(order[0]), compare_names);

    for (int i = 0; i < count; i++) run_vector(root, order[i]);

    printf("format v3 conformance (C): %d/%d vectors passed; keyed verdicts %d/%d; "
           "primitive known answers %d/%d\n",
           g_passed, g_checked, g_keyed_passed, g_keyed_checked, g_kat_passed,
           g_kat_checked);

    for (int i = 0; i < g_skipped_count; i++) {
        printf("  skipped: %s\n", g_skipped[i]);
    }

    if (g_failure_count > 0) {
        printf("\n%d failure(s):\n", g_failure_count);
        for (int i = 0; i < g_failure_count; i++) printf("  %s\n", g_failures[i]);
        return 1;
    }

    /* A skipped vector is a vector nobody checked. */
    if (g_checked == 0 || g_skipped_count > 0 || g_passed != g_checked) {
        fprintf(stderr, "not every vector was checked\n");
        return 2;
    }

    return 0;
}
